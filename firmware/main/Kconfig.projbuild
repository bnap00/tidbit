## firmware/main/Kconfig.projbuild
```kconfig
menu "Tidbit"
  choice PAL_BOARD
    prompt "Board"
    default PAL_BOARD_WAVESHARE_AMOLED_18
    config PAL_BOARD_WAVESHARE_AMOLED_18
      bool "Waveshare ESP32-S3-Touch-AMOLED-1.8"
  endchoice
  choice PAL_WS_REV
    prompt "Waveshare revision"
    depends on PAL_BOARD_WAVESHARE_AMOLED_18
    default PAL_WS_REV_AUTO
    config PAL_WS_REV_AUTO
      bool "Detect from the touch controller"
    config PAL_WS_REV_V1
      bool "V1: SH8601 screen, FT3168 touch"
    config PAL_WS_REV_V2
      bool "V2: CO5300 screen, CST820 touch"
  endchoice
  config PAL_WIFI_SSID
    string "Wi-Fi network (optional; otherwise set up on the device)"
    default ""
  config PAL_WIFI_PASSWORD
    string "Wi-Fi password"
    default ""
  config PAL_SERVER
    string "Tidbit web server, host:port (e.g. 192.168.1.20:5174)"
    default ""
  config PAL_DARK
    bool "Dark backdrop (a glow behind the pal, black edges)"
    default y
  config PAL_OTA_PASSWORD
    string "Password for updates over Wi-Fi (ota.sh); empty turns them off"
    default ""
  config PAL_SCREEN_OFF_S
    int "Screen off after this many seconds alone (0 = never)"
    range 0 3600
    default 30
  config PAL_FPS
    int "Frames per second asked of the brain"
    range 1 30
    default 24
endmenu
```

## firmware/sdkconfig.defaults
```kconfig
CONFIG_IDF_TARGET="esp32s3"
CONFIG_ESPTOOLPY_FLASHSIZE_16MB=y
CONFIG_ESPTOOLPY_FLASHMODE_QIO=y
CONFIG_PARTITION_TABLE_CUSTOM=y
CONFIG_PARTITION_TABLE_CUSTOM_FILENAME="partitions.csv"
CONFIG_ESP_DEFAULT_CPU_FREQ_MHZ_240=y
CONFIG_SPIRAM=y
CONFIG_SPIRAM_MODE_OCT=y
CONFIG_SPIRAM_SPEED_80M=y
CONFIG_SPIRAM_USE_MALLOC=y
CONFIG_SPIRAM_MALLOC_ALWAYSINTERNAL=4096
CONFIG_SPIRAM_TRY_ALLOCATE_WIFI_LWIP=y
CONFIG_ESP_MAIN_TASK_STACK_SIZE=8192
CONFIG_COMPILER_OPTIMIZATION_PERF=y
CONFIG_ESP_CONSOLE_USB_SERIAL_JTAG=y
CONFIG_HTTPD_MAX_REQ_HDR_LEN=1024
CONFIG_LWIP_MAX_SOCKETS=16
CONFIG_FREERTOS_HZ=1000
# A new build that crashes before marking itself good (after 30 s) is rolled back.
CONFIG_BOOTLOADER_APP_ROLLBACK_ENABLE=y
CONFIG_MDNS_MAX_INTERFACES=3
```
